ASAP2_VERSION 1 61
/begin PROJECT DH.XCP.SAMPLE "XCP sim project"
/begin HEADER "Project header" VERSION "DH A100" PROJECT_NO DH20221 /end HEADER
/include engine_ecu.a2l
/include lights_ecu.a2l
/end PROJECT
